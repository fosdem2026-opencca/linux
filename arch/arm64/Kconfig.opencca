## arch/arm64/Kconfig.opencca
```kconfig
menu "OpenCCA Options"

config OPENCCA_HW_DEBUG
	bool "Enable Hardware Debugging"
    default n
	help
	  Enable hardware debugging


config OPENCCA_DEMO
	bool "Enable Device GPU Demo"
    default n
	help
	  Demo to demostrate interaction with GPU in CVM.



endmenu
```
